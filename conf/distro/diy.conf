## conf/distro/diy.conf
```bitbake
require conf/distro/poky.conf

# Set the name of the distribution
DISTRO = "diy"

# Set the package management system
PACKAGE_CLASSES ?= "package_deb"

INIT_MANAGER ?= "systemd"

# Add any other custom configurations here
DISTRO_FEATURES:remove = "x11"
DISTRO_FEATURES:append = " wayland"
ENABLE_UART = "1"

RUST_VERSION ?= "1.75.0"

PREFERRED_VERSION_cargo ?= "${RUST_VERSION}"
PREFERRED_VERSION_cargo-native ?= "${RUST_VERSION}"
PREFERRED_VERSION_libstd-rs ?= "${RUST_VERSION}"
PREFERRED_VERSION_rust ?= "${RUST_VERSION}"
PREFERRED_VERSION_rust-cross-${TARGET_ARCH} ?= "${RUST_VERSION}"
PREFERRED_VERSION_rust-llvm ?= "${RUST_VERSION}"
PREFERRED_VERSION_rust-llvm-native ?= "${RUST_VERSION}"
PREFERRED_VERSION_rust-native ?= "${RUST_VERSION}"
```

## conf/layer.conf
```bitbake
# We have a conf and classes directory, add to BBPATH
BBPATH .= ":${LAYERDIR}"

# We have recipes-* directories, add to BBFILES
BBFILES += "${LAYERDIR}/recipes-*/*/*.bb \
	${LAYERDIR}/recipes-*/*/*.bbappend"

BBFILE_COLLECTIONS += "diy"
BBFILE_PATTERN_diy = "^${LAYERDIR}/"
BBFILE_PRIORITY_diy = "6"

LAYERSERIES_COMPAT_diy = "scarthgap"
```
